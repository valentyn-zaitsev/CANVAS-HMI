## sdkconfig.defaults
```kconfig
# Disable WiFi (not used, saves ~20KB DRAM)
CONFIG_ESP_WIFI_ENABLED=n

# BLE disabled (was breaking touch I2C)
CONFIG_BT_ENABLED=n

# FATFS long filenames
CONFIG_FATFS_LFN_HEAP=y
CONFIG_FATFS_MAX_LFN=64

# LVGL fonts
CONFIG_LV_FONT_MONTSERRAT_12=y
CONFIG_LV_FONT_MONTSERRAT_14=y

# LVGL memory pool
CONFIG_LV_MEM_SIZE_KILOBYTES=64

# Watchdog
CONFIG_ESP_TASK_WDT_TIMEOUT_S=10

# Halt on panic so we can read the error
CONFIG_ESP_SYSTEM_PANIC_PRINT_HALT=y
```
